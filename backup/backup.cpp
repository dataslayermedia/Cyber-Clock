#include <WiFi.h>
#include <SPI.h>
#include <NTPClient.h>
#include <WiFiUdp.h>
#include <Adafruit_GFX.h>
#include <Adafruit_SSD1306.h>
#include <DHT.h>
#define SCREEN_WIDTH 128 // OLED display width, in pixels
#define SCREEN_HEIGHT 64 // OLED display height, in pixels
#define ANALOG_PIN D1      // Analog pin connected to the voltage divider
#define ADC_MAX 4095      // 12-bit ADC
#define REF_VOLTAGE 2.8   // Reference voltage of ADC (3.3V for Xiao ESP32C3)
// WiFi credentials
const char* ssid     = "honeypot";//your ssid
const char* password = "honeyishrunkthekids";//your wifi password 
// OLED display SPI pins
#define OLED_MOSI    D10
#define OLED_CLK     D8
#define OLED_DC      D4
#define OLED_CS      D7
#define OLED_RESET   D5
Adafruit_SSD1306 display(SCREEN_WIDTH, SCREEN_HEIGHT,
  OLED_MOSI, OLED_CLK, OLED_DC, OLED_RESET, OLED_CS);
#define DHTPIN D0
#define DHTTYPE    DHT11
DHT dht(DHTPIN, DHTTYPE);
// NTP client to get time
WiFiUDP ntpUDP;
NTPClient timeClient(ntpUDP, "pool.ntp.org", 19800, 0);
//bit ui bitmap
static const unsigned char PROGMEM image_paint_1_bits[] = {0x60,0xf0,0x90,0x90,0x90,0x90,0xf0};
static const unsigned char PROGMEM image_paint_0_bits[] = {0x7e,0x3f,0x3f,0xff,0xff,0xff,0xff,0xff,0xff,0xff,0xff,0xff,0xff,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0x00,0x92};



float readBatteryVoltage() {
  int analogValue = analogRead(ANALOG_PIN);
  float voltage = (analogValue / (float)ADC_MAX) * REF_VOLTAGE;
  
  // Print raw analog value for debugging
  if(Serial) Serial.print("Analog value: ");
  if(Serial) Serial.println(analogValue);
  
  // Voltage divider scaling
  voltage = voltage * (10.5 + 10) / 10.0; // (R1 + R2) / R2
  
  // Print voltage for debugging
  if(Serial) Serial.print("Battery voltage: ");
  if(Serial) Serial.println(voltage);
  
  return voltage;
}

// Function to calculate battery percentage
float calculateBatteryPercentage(float voltage) {
  float percentage;
  // Assuming a linear relationship between voltage and percentage
  if (voltage >= 4.2) {
    percentage = 100.0;
  } else if (voltage <= 2.5) {
    percentage = 0.0;
  } else {
    percentage = (voltage - 2.5) / (4.2 - 2.5) * 100.0;
  }
  
  // Print battery percentage for debugging
  if(Serial) Serial.print("Battery percentage: ");
  if(Serial) Serial.println(percentage);
  
  return percentage;
}

void setup() {
  // Start serial communication

  Serial.println("Test");

  
  if(Serial) Serial.begin(115200);
  dht.begin();
  analogReadResolution(12); // Set ADC resolution to 12-bit
  // Initialize OLED display
  if(!display.begin(SSD1306_SWITCHCAPVCC)) {
    if(Serial) Serial.println(F("SSD1306 allocation failed"));
    for(;;); // Don't proceed, loop forever;
  }

  // Display initial message
  if(Serial) Serial.println("Starting setup...");
  
  // Print battery information regardless of Wi-Fi status
  float batteryVoltage = readBatteryVoltage();
  float batteryPercentage = calculateBatteryPercentage(batteryVoltage);

  // Connect to Wi-Fi
  WiFi.begin(ssid, password);
  while (WiFi.status() != WL_CONNECTED) {
    delay(1000);
    if(Serial) Serial.println("Connecting to WiFi...");
    // Print battery information while trying to connect to Wi-Fi
    batteryVoltage = readBatteryVoltage();
    batteryPercentage = calculateBatteryPercentage(batteryVoltage);
  }
  
  if(Serial) Serial.println("Connected to WiFi");
  
  // Initialize time client
  timeClient.begin();
}

void loop() {
  // Update time from NTP server
  timeClient.update();
  unsigned long epochTime = timeClient.getEpochTime();
  struct tm *ptm = gmtime((time_t *)&epochTime);
  int monthDay = ptm->tm_mday;
  int currentMonth = ptm->tm_mon + 1;
  int currentYear = ptm->tm_year + 1900;
  int currentHour = ptm->tm_hour;
  int currentMinute = ptm->tm_min;
  int currentSecond = ptm->tm_sec;
  
  float batteryVoltage = readBatteryVoltage();
  float batteryPercentage = calculateBatteryPercentage(batteryVoltage);
  
  // Get temperature and humidity
  float t = dht.readTemperature();
  float h = dht.readHumidity();
  
  // Convert time to 12-hour format
  String period = "AM";
  if (currentHour >= 12) {
    period = "PM";
    if (currentHour > 12) {
      currentHour -= 12;
    }
  } else if (currentHour == 0) {
    currentHour = 12;
  }
  
  // Display data on OLED
  display.clearDisplay();
  display.setTextColor(SSD1306_WHITE);
  
  // Display time
  display.setCursor(19, 6);
  display.setTextSize(3);
  if (currentHour < 10) display.print('0');
  display.print(currentHour);
  display.print(':');
  if (currentMinute < 10) display.print('0');
  display.print(currentMinute);
  display.setTextSize(1);
  display.setCursor(108, 39);
  display.print(period);
  
  // Display date
  display.setCursor(36, 39);
  if (monthDay < 10) display.print('0');
  display.print(monthDay);
  display.print('/');
  if (currentMonth < 10) display.print('0');
  display.print(currentMonth);
  display.print('/');
  display.print(currentYear);
  
  // Display temperature
  display.setCursor(79, 53);
  display.print(t);
  display.print("C");
  
  // Display humidity
  display.setCursor(22, 53);
  display.print(h);
  display.print("%");
  
  display.drawBitmap(0, 0, image_paint_0_bits, 128, 64, 1);
  display.setCursor(14, 39);
  display.print(batteryPercentage, 0);
  display.drawBitmap(8, 39, image_paint_1_bits, 4, 7, 1);
  display.display();
  
  // Delay before the next update
  delay(1000);
}